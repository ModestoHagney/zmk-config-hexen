## boards/shields/hexen/Kconfig.shield
```kconfig
config SHIELD_HEXEN_DONGLE
    def_bool $(shields_list_contains,hexen_dongle)

config SHIELD_HEXEN_LEFT
    def_bool $(shields_list_contains,hexen_left)

config SHIELD_HEXEN_RIGHT
    def_bool $(shields_list_contains,hexen_right)
```

## boards/shields/tilps/Kconfig.defconfig
```kconfig
# Copyright (c) 2020 The ZMK Contributors
# SPDX-License-Identifier: MIT

if SHIELD_TILPS_DONGLE

config ZMK_KEYBOARD_NAME
    default "Tilps Dongle"
    
config ZMK_SPLIT_BLE_ROLE_CENTRAL
    default y
    
config ZMK_USB
    default y

if ZMK_DISPLAY

config I2C
    default y

config SH1106
    default y

endif # ZMK_DISPLAY

endif

if SHIELD_TILPS_LEFT || SHIELD_TILPS_RIGHT || SHIELD_TILPS_DONGLE 

config ZMK_SPLIT
    default y

config ZMK_BLE
    default y
    
endif
```

## config/boards/shields/hexen/Kconfig.defconfig
```kconfig
if SHIELD_HEXEN_DONGLE

config ZMK_SPLIT
    default y

config ZMK_SPLIT_ROLE_CENTRAL
    default y

endif
```

## config/west.yml
```yaml
manifest:
  remotes:
    - name: zmkfirmware
      url-base: https://github.com/zmkfirmware
    #- name: englmaxi
    #  url-base: https://github.com/englmaxi
    # - name: carrefinho                            
    #   url-base: https://github.com/carrefinho
    - name: janpfischer
      url-base: https://github.com/janpfischer
  projects:
    - name: zmk
      remote: zmkfirmware
      revision: v0.3
      import: app/west.yml
    #- name: zmk-dongle-display
    #  remote: englmaxi
    #  revision: v0.3
    # - name: prospector-zmk-module
    #   remote: carrefinho
    #   revision: main
    - name: zmk-dongle-screen
      remote: janpfischer
      revision: main
  self:
    path: config
```
